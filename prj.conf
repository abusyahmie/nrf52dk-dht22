## CMakeLists.txt
```
cmake_minimum_required(VERSION 3.20.0)
find_package(Zephyr REQUIRED HINTS $ENV{ZEPHYR_BASE})

project(dht22)

target_sources(app PRIVATE src/main.c)
```

## prj.conf
```kconfig
CONFIG_LOG=y
CONFIG_SENSOR=y
CONFIG_DHT=y
CONFIG_CBPRINTF_FP_SUPPORT=y

# Bluetooth
CONFIG_BT=y
CONFIG_BT_PERIPHERAL=y
CONFIG_BT_DEVICE_NAME="nRF52-DHT22"
CONFIG_BT_MAX_CONN=1
```

## boards/nrf52dk_nrf52832.overlay
```dts
/{
    aliases{
		dht22 = &dht22;
	};
	dht22: dht {
        compatible = "aosong,dht";
        status = "okay";
        label = "DHT22";
        dio-gpios = <&gpio0 11 GPIO_ACTIVE_HIGH >;  // Replace with the ports and pins you will be using
		dht22;
    };
};
```

## src/main.c
```c
#include <zephyr/device.h>
#include <zephyr/drivers/gpio.h>
#include <zephyr/kernel.h>
#include <zephyr/logging/log.h>
#include <zephyr/sys/byteorder.h>

#include <zephyr/bluetooth/bluetooth.h>
#include <zephyr/bluetooth/hci.h>
#include <zephyr/bluetooth/conn.h>
#include <zephyr/bluetooth/gatt.h>
#include <zephyr/bluetooth/gap.h> /* needed for BT_LE_ADV_PARAM if available */

LOG_MODULE_REGISTER(main);

#define DHT22_NODE DT_ALIAS(dht22)

#if !DT_NODE_HAS_STATUS(DHT22_NODE, okay)
#error "DHT22 node is not okay"
#endif

static const struct gpio_dt_spec dht22 =
    GPIO_DT_SPEC_GET(DHT22_NODE, dio_gpios);

/* Last-measured values in tenths:
 * temperature: int16_t (tenths of °C, signed)
 * humidity: uint16_t (tenths of %RH)
 */
static int16_t last_temp_tenths = 0;
static uint16_t last_hum_tenths = 0;

static struct bt_conn *current_conn;
static bool temp_notify_enabled;
static bool hum_notify_enabled;

void dht22_start_signal(void) {
    gpio_pin_configure_dt(&dht22, GPIO_OUTPUT);
    gpio_pin_set_dt(&dht22, 0); // Pull low
    k_msleep(20);               // Hold low for at least 18ms

    gpio_pin_set_dt(&dht22, 1); // Pull high
    k_busy_wait(30);            // 20-40 us

    gpio_pin_configure_dt(&dht22, GPIO_INPUT); // Release & switch to input
}

int dht22_wait_for(int level, uint32_t timeout_us) {
    uint32_t count = 0;
    while (gpio_pin_get_dt(&dht22) != level) {
        if (count++ > timeout_us) {
            return -1;
        }
        k_busy_wait(1);
    }
    return 0;
}

int dht22_read_bit(void) {
    if (dht22_wait_for(1, 100))
        return -1;
    k_busy_wait(40); // wait 40us
    int bit = gpio_pin_get_dt(&dht22);
    if (dht22_wait_for(0, 100))
        return -1;
    return bit;
}

int dht22_read(uint8_t data[5]) {
    memset(data, 0, 5);
    dht22_start_signal();

    if (dht22_wait_for(0, 100))
        return -1; // DHT pulls low
    if (dht22_wait_for(1, 100))
        return -1; // DHT pulls high
    if (dht22_wait_for(0, 100))
        return -1; // DHT pulls low to start data

    for (int i = 0; i < 40; i++) {
        int bit = dht22_read_bit();
        if (bit < 0)
            return -1;

        data[i / 8] <<= 1;
        if (bit)
            data[i / 8] |= 1;
    }
    LOG_HEXDUMP_INF(data, sizeof(data), "Data Hexdump:");

    // Checksum
    uint8_t sum = data[0] + data[1] + data[2] + data[3];
    if (sum != data[4])
        return -2;

    return 0;
}

/* Helper: sample DHT22 and update last_* variables */
static int sample_dht22_and_update(void)
{
    uint8_t data[5];
    int rc = dht22_read(data);
    if (rc != 0) {
        LOG_ERR("DHT22 read failed (%d)", rc);
        return rc;
    }

    uint16_t raw_hum = (data[0] << 8) | data[1];
    uint16_t raw_temp = (data[2] << 8) | data[3];

    float hum = raw_hum * 0.1f;
    float temp = raw_temp * 0.1f;
    if (raw_temp & 0x8000) {
        temp = -temp;
    }

    last_hum_tenths = (uint16_t)(hum * 10.0f + 0.5f);
    last_temp_tenths = (int16_t)(temp * 10.0f + (temp >= 0 ? 0.5f : -0.5f));

    LOG_INF("Sampled Temp: %.1f C  Humidity: %.1f %%", (float)last_temp_tenths/10.0f, (float)last_hum_tenths/10.0f);
    return 0;
}

/* ===== BLE GATT service =====
 * Custom 128-bit UUIDs (replace if you want stable UUIDs)
 */
static struct bt_uuid_128 dht_svc_uuid = BT_UUID_INIT_128(
    0x23,0x01,0x45,0x67,0x89,0xab,0xcd,0xef,0x01,0x23,0x45,0x67,0x89,0xab,0xcd,0xef);
static struct bt_uuid_128 temp_char_uuid = BT_UUID_INIT_128(
    0x23,0x02,0x45,0x67,0x89,0xab,0xcd,0xef,0x01,0x23,0x45,0x67,0x89,0xab,0xcd,0xef);
static struct bt_uuid_128 hum_char_uuid = BT_UUID_INIT_128(
    0x23,0x03,0x45,0x67,0x89,0xab,0xcd,0xef,0x01,0x23,0x45,0x67,0x89,0xab,0xcd,0xef);

/* Read handlers return the last-measured values (little-endian) */
static ssize_t read_temp(struct bt_conn *conn, const struct bt_gatt_attr *attr,
                         void *buf, uint16_t len, uint16_t offset)
{
    uint16_t val_le = sys_cpu_to_le16((uint16_t)last_temp_tenths);
    return bt_gatt_attr_read(conn, attr, buf, len, offset, &val_le, sizeof(val_le));
}

static ssize_t read_hum(struct bt_conn *conn, const struct bt_gatt_attr *attr,
                        void *buf, uint16_t len, uint16_t offset)
{
    uint16_t val_le = sys_cpu_to_le16(last_hum_tenths);
    return bt_gatt_attr_read(conn, attr, buf, len, offset, &val_le, sizeof(val_le));
}

/* CCC changed callbacks */
static void temp_ccc_changed(const struct bt_gatt_attr *attr, uint16_t value)
{
    temp_notify_enabled = (value == BT_GATT_CCC_NOTIFY);
    LOG_INF("Temp notifications %s", temp_notify_enabled ? "enabled" : "disabled");
}

static void hum_ccc_changed(const struct bt_gatt_attr *attr, uint16_t value)
{
    hum_notify_enabled = (value == BT_GATT_CCC_NOTIFY);
    LOG_INF("Humidity notifications %s", hum_notify_enabled ? "enabled" : "disabled");
}

/* Service definition */
BT_GATT_SERVICE_DEFINE(dht_svc,
    BT_GATT_PRIMARY_SERVICE(&dht_svc_uuid),
    BT_GATT_CHARACTERISTIC(&temp_char_uuid.uuid,
                           BT_GATT_CHRC_READ | BT_GATT_CHRC_NOTIFY,
                           BT_GATT_PERM_READ, read_temp, NULL, NULL),
    BT_GATT_CCC(temp_ccc_changed, BT_GATT_PERM_READ | BT_GATT_PERM_WRITE),
    BT_GATT_CHARACTERISTIC(&hum_char_uuid.uuid,
                           BT_GATT_CHRC_READ | BT_GATT_CHRC_NOTIFY,
                           BT_GATT_PERM_READ, read_hum, NULL, NULL),
    BT_GATT_CCC(hum_ccc_changed, BT_GATT_PERM_READ | BT_GATT_PERM_WRITE),
);

/* Connection callbacks */
static void connected(struct bt_conn *conn, uint8_t err)
{
    if (err) {
        LOG_ERR("Connection failed (err %u)", err);
        return;
    }
    LOG_INF("Connected");
    if (current_conn) {
        bt_conn_unref(current_conn);
    }
    current_conn = bt_conn_ref(conn);
}

static void disconnected(struct bt_conn *conn, uint8_t reason)
{
    LOG_INF("Disconnected (reason 0x%02x)", reason);
    if (current_conn) {
        bt_conn_unref(current_conn);
        current_conn = NULL;
    }
    /* clear notify enabled flags: centrals lost subscription */
    temp_notify_enabled = false;
    hum_notify_enabled = false;
}

static struct bt_conn_cb conn_callbacks = {
    .connected = connected,
    .disconnected = disconnected,
};

/* Helper to notify if enabled. We notify all subscribed connections (pass NULL). */
/* value is a pointer to 16-bit little-endian value. attr_index: 2 for temp val, 5 for hum val in our BT_GATT_SERVICE_DEFINE order */
static void notify_if_enabled(bool enabled, const void *value, size_t vlen, size_t attr_index)
{
    if (!enabled) {
        return;
    }

    /* The BT_GATT_SERVICE_DEFINE creates dht_svc.attrs[] array:
     * index mapping (service definition ordering):
     * 0: primary service
     * 1: temp characteristic declaration
     * 2: temp characteristic value  <-- notify this
     * 3: temp CCC
     * 4: hum characteristic declaration
     * 5: hum characteristic value   <-- notify this
     * 6: hum CCC
     */
    /* dht_svc.attrs is a pointer; use attr_count instead of ARRAY_SIZE */
    if (attr_index >= dht_svc.attr_count) {
         return;
     }
     const struct bt_gatt_attr *attr = &dht_svc.attrs[attr_index];
     int rc = bt_gatt_notify(current_conn, attr, value, vlen);
     if (rc) {
         LOG_ERR("bt_gatt_notify failed: %d", rc);
     }
}

int main(void) {
    if (!gpio_is_ready_dt(&dht22)) {
        LOG_ERR("GPIO not ready");
        return 0;
    }

    LOG_INF("NRF52 DK and DHT22 sensor interfacing (with BLE)");

    /* Initialize Bluetooth */
    int err = bt_enable(NULL);
    if (err) {
        LOG_ERR("Bluetooth init failed (%d)", err);
    } else {
        LOG_INF("Bluetooth initialized");
    }

    bt_conn_cb_register(&conn_callbacks);

    /* Advertising data -- use runtime name length to avoid accidental oversized AD */
    const char *dev_name = bt_get_name();
    const struct bt_data ad[] = {
        BT_DATA_BYTES(BT_DATA_FLAGS, (BT_LE_AD_GENERAL | BT_LE_AD_NO_BREDR)),
        BT_DATA(BT_DATA_NAME_COMPLETE, dev_name, strlen(dev_name)),
    };

    
// Preferred: use explicit advertising parameter macros instead of deprecated connectable options.
// BT_LE_ADV_CONN_FAST_1 uses 100 ms fast advertising.
    err = bt_le_adv_start(
        BT_LE_ADV_CONN_FAST_1,
        ad, ARRAY_SIZE(ad), NULL, 0);

    if (err) {
        LOG_ERR("Advertising failed to start (err %d)", err);
        /* EINVAL often means AD too big or invalid params — print name length & AD size */
        LOG_INF("dev_name='%s' len=%zu ad_entries=%zu", dev_name, strlen(dev_name), ARRAY_SIZE(ad));
    } else {
        LOG_INF("Advertising started");
    }

    /* warm sample */
    sample_dht22_and_update();

    while (1) {
        int rc = sample_dht22_and_update();
        if (rc == 0) {
            /* Prepare little-endian 16-bit values */
            uint16_t temp_le = sys_cpu_to_le16((uint16_t)last_temp_tenths);
            uint16_t hum_le = sys_cpu_to_le16(last_hum_tenths);

            /* Notify if subscribed:
             * temp value attr index = 2, hum value attr index = 5 (see comment above)
             */
            notify_if_enabled(temp_notify_enabled, &temp_le, sizeof(temp_le), 2);
            notify_if_enabled(hum_notify_enabled, &hum_le, sizeof(hum_le), 5);
        } else {
            LOG_WRN("Skipping notify due to sensor read error");
        }

        k_sleep(K_SECONDS(5));
    }

    return 0;
}
```

## src/sensor_ble_template.c
```c
#include <zephyr/kernel.h>
#include <zephyr/logging/log.h>
#include <zephyr/sys/byteorder.h>
#include <zephyr/bluetooth/bluetooth.h>
#include <zephyr/bluetooth/gatt.h>
#include <zephyr/bluetooth/conn.h>
#include <zephyr/bluetooth/gap.h>
#include <string.h>

LOG_MODULE_REGISTER(sensor_ble_template, LOG_LEVEL_INF);

/* -- Configuration defaults -- */
#define DEFAULT_SAMPLE_PERIOD_S 5   /* seconds */
#define MIN_SAMPLE_PERIOD_S     1
#define MAX_SAMPLE_PERIOD_S     3600

/* Last-measured values in tenths (user-chosen format) */
static int16_t last_temp_tenths = 0;
static uint16_t last_hum_tenths = 0;

/* Protect shared values */
static struct k_mutex data_lock;

/* Sampling period (seconds) */
static atomic_t sample_period_s;

/* Connection + subscription state */
static struct bt_conn *current_conn;
static bool temp_notify_enabled;
static bool hum_notify_enabled;

/* Forward declarations */
static void sample_and_notify(struct k_work *work);

/* Work item for periodic sampling */
static struct k_work_delayable sample_work;

/* ======= GATT UUIDs (custom example) ======= */
static struct bt_uuid_128 svc_uuid = BT_UUID_INIT_128(
    0x23,0x01,0x45,0x67,0x89,0xab,0xcd,0xef,0x01,0x23,0x45,0x67,0x89,0xab,0xcd,0xef);
static struct bt_uuid_128 temp_uuid = BT_UUID_INIT_128(
    0x23,0x02,0x45,0x67,0x89,0xab,0xcd,0xef,0x01,0x23,0x45,0x67,0x89,0xab,0xcd,0xef);
static struct bt_uuid_128 hum_uuid = BT_UUID_INIT_128(
    0x23,0x03,0x45,0x67,0x89,0xab,0xcd,0xef,0x01,0x23,0x45,0x67,0x89,0xab,0xcd,0xef);
static struct bt_uuid_128 sampling_period_uuid = BT_UUID_INIT_128(
    0x23,0x04,0x45,0x67,0x89,0xab,0xcd,0xef,0x01,0x23,0x45,0x67,0x89,0xab,0xcd,0xef);

/* ---------- GATT read handlers ---------- */
static ssize_t read_temp(struct bt_conn *conn, const struct bt_gatt_attr *attr,
                         void *buf, uint16_t len, uint16_t offset)
{
    uint16_t temp_le;
    k_mutex_lock(&data_lock, K_FOREVER);
    temp_le = sys_cpu_to_le16((uint16_t)last_temp_tenths);
    k_mutex_unlock(&data_lock);
    return bt_gatt_attr_read(conn, attr, buf, len, offset, &temp_le, sizeof(temp_le));
}

static ssize_t read_hum(struct bt_conn *conn, const struct bt_gatt_attr *attr,
                         void *buf, uint16_t len, uint16_t offset)
{
    uint16_t hum_le;
    k_mutex_lock(&data_lock, K_FOREVER);
    hum_le = sys_cpu_to_le16(last_hum_tenths);
    k_mutex_unlock(&data_lock);
    return bt_gatt_attr_read(conn, attr, buf, len, offset, &hum_le, sizeof(hum_le));
}

/* Sampling period read/write handler (uint16_t seconds) */
static ssize_t read_sample_period(struct bt_conn *conn, const struct bt_gatt_attr *attr,
                                  void *buf, uint16_t len, uint16_t offset)
{
    uint16_t sp = (uint16_t)atomic_get(&sample_period_s);
    uint16_t le = sys_cpu_to_le16(sp);
    return bt_gatt_attr_read(conn, attr, buf, len, offset, &le, sizeof(le));
}

static ssize_t write_sample_period(struct bt_conn *conn, const struct bt_gatt_attr *attr,
                                   const void *buf, uint16_t len, uint16_t offset, uint8_t flags)
{
    if (offset != 0 || len != sizeof(uint16_t)) {
        return BT_GATT_ERR(BT_ATT_ERR_INVALID_OFFSET);
    }
    uint16_t in_le;
    memcpy(&in_le, buf, sizeof(in_le));
    uint16_t new_sp = sys_le16_to_cpu(in_le);
    if (new_sp < MIN_SAMPLE_PERIOD_S || new_sp > MAX_SAMPLE_PERIOD_S) {
        return BT_GATT_ERR(BT_ATT_ERR_INVALID_ATTRIBUTE_LEN);
    }
    atomic_set(&sample_period_s, new_sp);
    LOG_INF("Sampling period set to %u s", new_sp);

    /* reschedule sampling work with new period */
    k_work_reschedule(&sample_work, K_SECONDS(new_sp));
    return len;
}

/* CCC changed callbacks */
static void temp_ccc_changed(const struct bt_gatt_attr *attr, uint16_t value)
{
    temp_notify_enabled = (value == BT_GATT_CCC_NOTIFY);
    LOG_INF("Temp notify %s", temp_notify_enabled ? "on" : "off");
}

static void hum_ccc_changed(const struct bt_gatt_attr *attr, uint16_t value)
{
    hum_notify_enabled = (value == BT_GATT_CCC_NOTIFY);
    LOG_INF("Hum notify %s", hum_notify_enabled ? "on" : "off");
}

/* ---------- GATT service definition ---------- */
BT_GATT_SERVICE_DEFINE(sensor_svc,
    BT_GATT_PRIMARY_SERVICE(&svc_uuid),
    /* Temperature characteristic: uint16_t (tenths), read + notify */
    BT_GATT_CHARACTERISTIC(&temp_uuid.uuid,
                           BT_GATT_CHRC_READ | BT_GATT_CHRC_NOTIFY,
                           BT_GATT_PERM_READ, read_temp, NULL, NULL),
    BT_GATT_CCC(temp_ccc_changed, BT_GATT_PERM_READ | BT_GATT_PERM_WRITE),

    /* Humidity characteristic: uint16_t (tenths), read + notify */
    BT_GATT_CHARACTERISTIC(&hum_uuid.uuid,
                           BT_GATT_CHRC_READ | BT_GATT_CHRC_NOTIFY,
                           BT_GATT_PERM_READ, read_hum, NULL, NULL),
    BT_GATT_CCC(hum_ccc_changed, BT_GATT_PERM_READ | BT_GATT_PERM_WRITE),

    /* Sampling period: uint16_t seconds, read + write */
    BT_GATT_CHARACTERISTIC(&sampling_period_uuid.uuid,
                           BT_GATT_CHRC_READ | BT_GATT_CHRC_WRITE,
                           BT_GATT_PERM_READ | BT_GATT_PERM_WRITE, read_sample_period,
                           write_sample_period, NULL),
);

/* Attribute indexes in sensor_svc.attrs:
 * 0: primary service
 * 1: temp char decl
 * 2: temp value   <-- notify attr index = 2
 * 3: temp CCC
 * 4: hum char decl
 * 5: hum value    <-- notify attr index = 5
 * 6: hum CCC
 * 7: sampling period char decl
 * 8: sampling period value
 */

/* ---------- Connection callbacks ---------- */
static void connected(struct bt_conn *conn, uint8_t err)
{
    if (err) {
        LOG_ERR("Connection failed (err %u)", err);
        return;
    }
    LOG_INF("Connected");
    if (current_conn) {
        bt_conn_unref(current_conn);
    }
    current_conn = bt_conn_ref(conn);
}

static void disconnected(struct bt_conn *conn, uint8_t reason)
{
    LOG_INF("Disconnected (0x%02x)", reason);
    if (current_conn) {
        bt_conn_unref(current_conn);
        current_conn = NULL;
    }
    temp_notify_enabled = false;
    hum_notify_enabled = false;
}

static struct bt_conn_cb conn_callbacks = {
    .connected = connected,
    .disconnected = disconnected,
};

/* ---------- Sensor sampling API (plug your sensor code here) ---------- */
/* Implement your own sensor read. Return 0 on success.
 * temp_tenths: signed tenths of degree Celsius (e.g., 215 => 21.5C)
 * hum_tenths: unsigned tenths of %RH (e.g., 553 => 55.3%)
 */
static int sensor_read(int16_t *temp_tenths, uint16_t *hum_tenths)
{
    /* Placeholder implementation: replace with GPIO/I2C/SPI sensor read logic */
    static int16_t t = 200; /* 20.0C */
    static uint16_t h = 500; /* 50.0% */
    t += 1; if (t > 300) t = 200;
    h += 2; if (h > 800) h = 500;
    *temp_tenths = t;
    *hum_tenths = h;
    return 0;
}

/* ---------- Notify helper ---------- */
static void notify_if_enabled(bool enabled, size_t attr_index, const void *value, size_t vlen)
{
    if (!enabled || !current_conn) {
        return;
    }

    if (attr_index >= sensor_svc.attr_count) { /* attr_count is runtime */
        return;
    }

    const struct bt_gatt_attr *attr = &sensor_svc.attrs[attr_index];
    int rc = bt_gatt_notify(current_conn, attr, value, vlen);
    if (rc) {
        LOG_ERR("bt_gatt_notify failed: %d", rc);
    }
}

/* ---------- Sampling work handler ---------- */
static void sample_and_notify(struct k_work *work)
{
    ARG_UNUSED(work);

    int16_t temp;
    uint16_t hum;
    if (sensor_read(&temp, &hum) == 0) {
        k_mutex_lock(&data_lock, K_FOREVER);
        last_temp_tenths = temp;
        last_hum_tenths = hum;
        k_mutex_unlock(&data_lock);

        /* Prepare little-endian values */
        uint16_t temp_le = sys_cpu_to_le16((uint16_t)last_temp_tenths);
        uint16_t hum_le = sys_cpu_to_le16(last_hum_tenths);

        notify_if_enabled(temp_notify_enabled, 2, &temp_le, sizeof(temp_le)); /* temp attr idx = 2 */
        notify_if_enabled(hum_notify_enabled, 5, &hum_le, sizeof(hum_le));     /* hum attr idx = 5 */
    } else {
        LOG_WRN("Sensor read failed");
    }

    /* Reschedule according to sample_period_s */
    uint32_t sp = (uint32_t)atomic_get(&sample_period_s);
    k_work_reschedule(&sample_work, K_SECONDS(sp));
}

/* ---------- Initialization & advertising ---------- */
static void start_advertising(void)
{
    const char *name = bt_get_name();
    const struct bt_data ad[] = {
        BT_DATA_BYTES(BT_DATA_FLAGS, (BT_LE_AD_GENERAL | BT_LE_AD_NO_BREDR)),
        BT_DATA(BT_DATA_NAME_COMPLETE, name, strlen(name)),
    };

    int err = bt_le_adv_start(
        BT_LE_ADV_PARAM(BT_LE_ADV_OPT_CONNECTABLE | BT_LE_ADV_OPT_USE_NAME,
                        BT_GAP_ADV_FAST_INT_MIN_2, BT_GAP_ADV_FAST_INT_MAX_2, NULL),
        ad, ARRAY_SIZE(ad), NULL, 0);
    if (err) {
        LOG_ERR("Advertising failed to start (err %d)", err);
    } else {
        LOG_INF("Advertising started");
    }
}

int init_ble_sensor(void)
{
    int err;

    k_mutex_init(&data_lock);
    atomic_set(&sample_period_s, DEFAULT_SAMPLE_PERIOD_S);
    k_work_init_delayable(&sample_work, sample_and_notify);

    err = bt_enable(NULL);
    if (err) {
        LOG_ERR("Bluetooth init failed: %d", err);
        return err;
    }
    LOG_INF("Bluetooth initialized");

    bt_conn_cb_register(&conn_callbacks);

    /* start advertising */
    start_advertising();

    /* initial immediate sample then schedule recurring */
    k_work_schedule(&sample_work, K_NO_WAIT);

    return 0;
}

/* Example app entry: call init_ble_sensor() from main() of your app */
```
